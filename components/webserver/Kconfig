## components/webserver/Kconfig
```kconfig
menu "Webserver Options"

config MAX_USERNAME_LENGTH
    int "Max Username Length"
    default 32
    help
        Set the maximum length for usernames used in the webserver authentication.

config MAX_PASSWORD_LENGTH
    int "Max Password Length"
    default 32
    help
        Set the maximum length for passwords used in the webserver authentication.

endmenu
```

## fpc-cpp-fw-main/sdkconfig.defaults
```kconfig
CONFIG_IDF_TARGET="esp32s3"

# Enable C++ exceptions and RTTI
CONFIG_COMPILER_CXX_EXCEPTIONS=y
CONFIG_COMPILER_CXX_RTTI=y

# Flash size
CONFIG_ESPTOOLPY_FLASHSIZE_4MB=y

# Stack size for main task
CONFIG_ESP_MAIN_TASK_STACK_SIZE=16000
```

## main/Kconfig.projbuild
```kconfig
menu "FPC MQTTS Configuration"

    config FPC_MQTTS_BROKER_URL
        string "MQTTS broker URL"
        default "mqtts://192.168.100.3"
        help
            URL of the MQTTS broker the device connects to (e.g. mqtts://host).

    config FPC_MQTTS_BROKER_PORT
        int "MQTTS broker port"
        default 8883
        help
            TCP port of the MQTTS broker.

    config FPC_MQTTS_OTA_SUBSCRIBE_TOPIC_JOB
        string "Subscribe topic: OTA job"
        default "/device/ota/{device_id}/firmware_update"
        help
            Topic subscribed to for firmware-update job messages.
            "{device_id}" is replaced at runtime with the device MAC.

    config FPC_MQTTS_OTA_SUBSCRIBE_TOPIC_ROLLBACK
        string "Subscribe topic: OTA rollback"
        default "/device/ota/{device_id}/firmware_rollback"
        help
            Topic subscribed to for firmware-rollback messages.
            "{device_id}" is replaced at runtime with the device MAC.

    config FPC_MQTTS_OTA_PUBLISH_TOPIC_CHECKIN
        string "Publish topic: OTA check-in"
        default "/device/ota/{device_id}/checkin"
        help
            Topic published to for device check-in messages.
            "{device_id}" is replaced at runtime with the device MAC.

    config FPC_MQTTS_OTA_PUBLISH_TOPIC_ACK
        string "Publish topic: OTA ack"
        default "/device/ota/{device_id}/ack"
        help
            Topic published to for firmware-update acknowledgements.
            "{device_id}" is replaced at runtime with the device MAC.

    config FPC_MQTTS_OTA_PUBLISH_TOPIC_PROGRESS
        string "Publish topic: OTA progress"
        default "/device/ota/{device_id}/progress"
        help
            Topic published to for firmware-update progress updates.
            "{device_id}" is replaced at runtime with the device MAC.

    config FPC_MQTTS_OTA_PUBLISH_TOPIC_RESULT
        string "Publish topic: OTA result"
        default "/device/ota/{device_id}/result"
        help
            Topic published to for firmware-update results.
            "{device_id}" is replaced at runtime with the device MAC.

    config FPC_MQTTS_OTA_PUBLISH_TOPIC_ERROR
        string "Publish topic: OTA error"
        default "/device/ota/{device_id}/error"
        help
            Topic published to for firmware-update errors.
            "{device_id}" is replaced at runtime with the device MAC.

endmenu

menu "FPC Current Sensor / Pump Monitor Experiment"

    config FPC_EXPERIMENT_MODE_ENABLE
        bool "Enable experiment-mode firmware"
        default n
        help
            When enabled, app_main() runs the profiling harness
            (fpc::experiment::run()) instead of the normal DeviceMode
            boot flow. See docs/experiments/current_sensor_pump_monitor_profiling.md.

    if FPC_EXPERIMENT_MODE_ENABLE

        config FPC_EXPERIMENT_ID
            int "Experiment to run (1-7)"
            range 1 7
            default 1
            help
                1: current-read latency
                2: current-read accuracy sweep
                3: consecutive-read throughput
                4: overcurrent detection tolerance
                5: state-change reaction latency
                6: relay trip latency
                7: multi-pump scaling behavior (max pumps)

        choice FPC_EXPERIMENT_SENSOR_BACKEND
            prompt "Current sensor backend (experiments 1-2)"
            default FPC_EXPERIMENT_BACKEND_SYNTHETIC
            help
                SYNTHETIC lets the harness build/run without any sensor
                hardware attached (firmware-overhead baseline only).

            config FPC_EXPERIMENT_BACKEND_INTERNAL_ADC
                bool "Internal ADC (ACS712)"
            config FPC_EXPERIMENT_BACKEND_ADS1115
                bool "ADS1115 over I2C (ACS712)"
            config FPC_EXPERIMENT_BACKEND_SYNTHETIC
                bool "Synthetic (no hardware)"
        endchoice

        config FPC_EXPERIMENT_SAMPLE_COUNT
            int "Sample count N (experiments 1, 3)"
            default 1000

        config FPC_EXPERIMENT_STEP_DELAY_MS
            int "Settling delay between accuracy-sweep steps (ms, experiment 2)"
            default 3000

        config FPC_EXPERIMENT_CHECK_INTERVAL_MS
            int "PumpMonitorTask check interval (ms, experiments 3, 7)"
            default 100

        config FPC_EXPERIMENT_PUMP_COUNT
            int "Number of pump monitors (experiment 7, max 10)"
            range 1 10
            default 10

        config FPC_EXPERIMENT_DURATION_S
            int "Run duration for task-driven experiments (s, experiments 5/6/7)"
            default 30

    endif

endmenu
```
